# file: chapter6_example2.ioc
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Mcu.Family=STM32F4
Mcu.Name=STM32F411V(C-E)Tx
Mcu.Package=LQFP100
NVIC.PriorityGroup=NVIC_PRIORITYGROUP_4
ProjectManager.HeapSize=0x200
ProjectManager.StackSize=0x400
ProjectManager.TargetToolchain=STM32CubeIDE
RCC.AHBFreq_Value=16000000
RCC.APB1Freq_Value=16000000
RCC.APB2Freq_Value=16000000
RCC.CortexFreq_Value=16000000
RCC.HSE_VALUE=25000000
RCC.HSI_VALUE=16000000
RCC.LSE_VALUE=32768
RCC.SYSCLKFreq_VALUE=16000000
RCC.VCOOutputFreq_Value=192000000
board=custom

// file: Core/Src/main.c
/* USER CODE BEGIN Header */
/**
  ******************************************************************************
  * @file           : main.c
  * @brief          : Main program body
  ******************************************************************************
  * @attention
  *
  * Copyright (c) 2025 STMicroelectronics.
  * All rights reserved.
  *
  * This software is licensed under terms that can be found in the LICENSE file
  * in the root directory of this software component.
  * If no LICENSE file comes with this software, it is provided AS-IS.
  *
  ******************************************************************************
  */
/* USER CODE END Header */
#include "main.h"

/* USER CODE BEGIN PV */
volatile uint32_t msTicks = 0;  // Biến đếm thời gian

// ISR - Trình phục vụ ngắt SysTick
void SysTick_Handler(void) {
    msTicks++;  // Tăng biến đếm mỗi khi có ngắt SysTick
}

void SysTick_Init(uint32_t ticks) {
    // Đặt giá trị reload cho thanh ghi SysTick Reload Value Register (LOAD)
    // Giảm 1 vì SysTick đếm từ giá trị reload xuống 0
    SysTick->LOAD = ticks - 1;

    // Xóa giá trị hiện tại của thanh ghi SysTick Current Value Register (VAL)
    // để khởi động lại bộ đếm
    SysTick->VAL = 0;

    // Cấu hình thanh ghi SysTick Control and Status Register (CTRL)
    // - Bật bộ đếm SysTick (bit 0: ENABLE)
    // - Kích hoạt ngắt SysTick (bit 1: TICKINT)
    // - Chọn nguồn xung là AHB (bit 2: CLKSOURCE)
    SysTick->CTRL = (1UL << 0) |  // ENABLE: Bật bộ đếm
                    (1UL << 1) |  // TICKINT: Cho phép ngắt
                    (1UL << 2);   // CLKSOURCE: Nguồn xung AHB
}

// Hàm tạo trễ theo mili-giây
void delay_ms(uint32_t delay) {
    uint32_t start = msTicks;
    while ((msTicks - start) < delay);  // Chờ cho đủ thời gian trễ
}
/* USER CODE END PV */

void SystemClock_Config(void);

int main(void)
{

  /* MCU Configuration--------------------------------------------------------*/

  /* Reset of all peripherals, Initializes the Flash interface and the Systick. */
  HAL_Init();

  /* Configure the system clock */
  SystemClock_Config();

  /* Initialize all configured peripherals */

  /* Infinite loop */
  /* USER CODE BEGIN WHILE */
  // Khởi tạo SysTick với tần số 1ms
  SysTick_Init(SystemCoreClock / 1000);

  // Cấu hình GPIOA Pin 5 làm output (LED)
  RCC->AHB1ENR |= RCC_AHB1ENR_GPIOAEN;  // Bật clock cho GPIOA
  GPIOA->MODER |= (1 << 10); // MODER5 = 01 (Output)
  while (1)
  {
      GPIOA->ODR ^= (1 << 5);
      // Đảo trạng thái LED tại Pin 5
      delay_ms(1000);          // Trễ 1 giây
    /* USER CODE END WHILE */

  }
}

void SystemClock_Config(void)
{
  RCC_OscInitTypeDef RCC_OscInitStruct = {0};
  RCC_ClkInitTypeDef RCC_ClkInitStruct = {0};

  /** Configure the main internal regulator output voltage
  */
  __HAL_RCC_PWR_CLK_ENABLE();
  __HAL_PWR_VOLTAGESCALING_CONFIG(PWR_REGULATOR_VOLTAGE_SCALE1);

  /** Initializes the RCC Oscillators according to the specified parameters
  * in the RCC_OscInitTypeDef structure.
  */
  RCC_OscInitStruct.OscillatorType = RCC_OSCILLATORTYPE_HSI;
  RCC_OscInitStruct.HSIState = RCC_HSI_ON;
  RCC_OscInitStruct.HSICalibrationValue = RCC_HSICALIBRATION_DEFAULT;
  RCC_OscInitStruct.PLL.PLLState = RCC_PLL_NONE;
  if (HAL_RCC_OscConfig(&RCC_OscInitStruct) != HAL_OK)
  {
    Error_Handler();
  }

  /** Initializes the CPU, AHB and APB buses clocks
  */
  RCC_ClkInitStruct.ClockType = RCC_CLOCKTYPE_HCLK|RCC_CLOCKTYPE_SYSCLK
                              |RCC_CLOCKTYPE_PCLK1|RCC_CLOCKTYPE_PCLK2;
  RCC_ClkInitStruct.SYSCLKSource = RCC_SYSCLKSOURCE_HSI;
  RCC_ClkInitStruct.AHBCLKDivider = RCC_SYSCLK_DIV1;
  RCC_ClkInitStruct.APB1CLKDivider = RCC_HCLK_DIV1;
  RCC_ClkInitStruct.APB2CLKDivider = RCC_HCLK_DIV1;

  if (HAL_RCC_ClockConfig(&RCC_ClkInitStruct, FLASH_LATENCY_0) != HAL_OK)
  {
    Error_Handler();
  }
}

void Error_Handler(void)
{
  __disable_irq();
  while (1)
  {
  }
}
